// Переопределяем параметры дисплея ST7789
&st7789 {
    width = <240>;      // новая ширина (было 240, оставляем или меняем)
    height = <294>;     // меняем высоту, например, на 320 пикселей
    x-offset = <20>;     // смещение по X (было 0)
    y-offset = <70>;    // новое вертикальное смещение (было 20)
};
