// st7789.overlay
#include <zephyr/dt-bindings/gpio/gpio.h>

&spi3 {
    status = "okay";
    cs-gpios = <&gpio1 6 GPIO_ACTIVE_LOW>; // CS на P1.06
    st7789v: st7789v@0 {
        compatible = "sitronix,st7789v";
        reg = <0>;
        spi-max-frequency = <20000000>;    // 20 MHz, можно снизить до 4M если рябь
        cmd-data-gpios = <&gpio1 4 GPIO_ACTIVE_LOW>; // DC на P1.04
        reset-gpios = <&gpio0 11 GPIO_ACTIVE_LOW>;   // RST на P0.11
        width = <240>;
        height = <240>;
    };
};